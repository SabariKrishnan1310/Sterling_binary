## factory/sdkconfig.defaults
```kconfig
# ═══════════════════════════════════════════════════════════
# STERLING BOOTSTRAP v2.0.0 — sdkconfig.defaults
# ═══════════════════════════════════════════════════════════
# Applied on top of sdkconfig during full clean build.
# ═══════════════════════════════════════════════════════════

# ── Target ──
CONFIG_IDF_TARGET="esp32"

# ── Partition Table ──
CONFIG_PARTITION_TABLE_CUSTOM=y
CONFIG_PARTITION_TABLE_CUSTOM_FILENAME="partitions.csv"

# ── Flash Size ──
CONFIG_ESPTOOLPY_FLASHSIZE_16MB=y
CONFIG_ESPTOOLPY_FLASHMODE_DIO=y
CONFIG_ESPTOOLPY_FLASHFREQ_40M=y

# ── HTTP Server ──
CONFIG_HTTPD_MAX_REQ_HDR_LEN=1024
CONFIG_HTTPD_MAX_URI_LEN=512
CONFIG_HTTPD_MAX_HDR_LEN=1024

# ── WiFi ──
CONFIG_ESP_WIFI_STATIC_RX_BUFFER_NUM=10
CONFIG_ESP_WIFI_DYNAMIC_RX_BUFFER_NUM=32
CONFIG_ESP_WIFI_DYNAMIC_TX_BUFFER_NUM=32
CONFIG_ESP_WIFI_AMPDU_TX_ENABLED=y
CONFIG_ESP_WIFI_AMPDU_RX_ENABLED=y
CONFIG_ESP_WIFI_SOFTAP_SUPPORT=y

# ── No WDT for app_main (simple bootstrap) ──
CONFIG_ESP_TASK_WDT_CHECK_IDLE_TASK_CPU0=y
CONFIG_ESP_TASK_WDT_TIMEOUT_S=30

# ── Stack Overflow Detection (Method 2 — canary) ──
CONFIG_FREERTOS_CHECK_STACKOVERFLOW_CANARY=y

# ── App Task Stack Size ──
CONFIG_ESP_MAIN_TASK_STACK_SIZE=8192

# ── Log Level ──
CONFIG_LOG_DEFAULT_LEVEL_INFO=y
CONFIG_LOG_MAXIMUM_LEVEL_DEBUG=y

# ── HTTPS (for OTA from GitHub raw) ──
CONFIG_ESP_TLS_USING_MBEDTLS=y

# ── Brownout ──
CONFIG_ESP_BROWNOUT_DET=y
CONFIG_ESP_BROWNOUT_DET_LVL_SEL_3V=y

# ── Compiler ──
CONFIG_COMPILER_OPTIMIZATION_PERF=y
```

## sdkconfig.defaults
```kconfig
CONFIG_FREERTOS_UNICORE=n
CONFIG_FREERTOS_HZ=1000
CONFIG_FREERTOS_USE_TRACE_FACILITY=y
CONFIG_FREERTOS_VTASKLIST_INCLUDE_COREID=y

CONFIG_ESP_TASK_WDT_EN=y
CONFIG_ESP_TASK_WDT_TIMEOUT_S=30
CONFIG_ESP_TASK_WDT_PANIC=y

CONFIG_PARTITION_TABLE_CUSTOM=y
CONFIG_PARTITION_TABLE_CUSTOM_FILENAME="partitions.csv"

CONFIG_LITTLEFS_MAX_PARTITIONS=3
CONFIG_LITTLEFS_SPIFFS_BLOCK_SIZE=4096

CONFIG_ESP_WIFI_STATIC_RX_BUFFER_NUM=10
CONFIG_ESP_WIFI_DYNAMIC_RX_BUFFER_NUM=32
CONFIG_ESP_WIFI_TX_BUFFER_TYPE=1
CONFIG_ESP_WIFI_STATIC_TX_BUFFER_NUM=16
CONFIG_ESP_WIFI_DYNAMIC_TX_BUFFER_NUM=32
CONFIG_ESP_WIFI_CSI_ENABLED=n
CONFIG_ESP_WIFI_AMPDU_TX_ENABLED=y
CONFIG_ESP_WIFI_AMPDU_RX_ENABLED=y
CONFIG_ESP_WIFI_IRAM_OPT=y
CONFIG_ESP_WIFI_RX_IRAM_OPT=y

CONFIG_ESP_HTTP_CLIENT_ENABLE_HTTPS=y

CONFIG_MBEDTLS_HARDWARE_AES=y
CONFIG_MBEDTLS_HARDWARE_MPI=y
CONFIG_MBEDTLS_HARDWARE_SHA=y
CONFIG_MBEDTLS_SSL_IN_CONTENT_LEN=16384
CONFIG_MBEDTLS_SSL_OUT_CONTENT_LEN=4096

CONFIG_OTA_ALLOW_HTTP=n
CONFIG_BOOTLOADER_APP_ROLLBACK_ENABLE=y
CONFIG_BOOTLOADER_APP_ANTI_ROLLBACK=n
CONFIG_BOOTLOADER_SKIP_VALIDATE_IN_DEEP_SLEEP=n
CONFIG_BOOTLOADER_SKIP_VALIDATE_ON_POWER_ON=n

CONFIG_NVS_ENCRYPTION=n

CONFIG_ESP_MAIN_TASK_STACK_SIZE=8192

CONFIG_LOG_DEFAULT_LEVEL=INFO
CONFIG_LOG_TIMESTAMP_SOURCE_RTOS=y

CONFIG_SPI_FLASH_WRITE_CHUNK_SIZE=8192

CONFIG_ESP32_DEFAULT_CPU_FREQ_240=y
CONFIG_ESP32_SPIRAM_SUPPORT=n

CONFIG_ESP_TASK_WDT_CHECK_IDLE_TASK_CPU1=y
```
